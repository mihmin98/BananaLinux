## kiwami/Config.in
```kconfig
menu "Kiwami"
source "$BR2_EXTERNAL_KIWAMI_PATH/package/kiwami-tailscale/Config.in"
source "$BR2_EXTERNAL_KIWAMI_PATH/package/kiwami-libretro-mesen/Config.in"
source "$BR2_EXTERNAL_KIWAMI_PATH/package/kiwami-libretro-sameboy/Config.in"
source "$BR2_EXTERNAL_KIWAMI_PATH/package/kiwami-libretro-genesis-plus-gx/Config.in"

config BR2_PACKAGE_KIWAMI_RETROARCH_MASTER
	bool "RetroArch's master instead of v1.22.2"
	depends on BR2_PACKAGE_RETROARCH
	help
	  RetroArch built from its master branch at the commit kiwami/local.mk pins, with the fork's patches
	  (kiwami/patches/retroarch/) instead of upstream's. Off, RetroArch is upstream's release.

config BR2_PACKAGE_KIWAMI_OTA_OFF
	bool "Over-the-air updates off"
	help
	  Settings > System > Update no longer checks or downloads upstream's releases (GitHub, the beta channel), which
	  would replace the fork: kiwami/post-build.sh sends the update script's check, download and beta-login to
	  /usr/libexec/kiwami/ota-off, which says so. Update packages on the card still install. Off, upstream's updates.
endmenu
```

## kiwami/package/kiwami-libretro-genesis-plus-gx/Config.in
```kconfig
config BR2_PACKAGE_KIWAMI_LIBRETRO_GENESIS_PLUS_GX
	bool "kiwami-libretro-genesis-plus-gx"
	depends on BR2_PACKAGE_RETROARCH
	help
	  Genesis Plus GX, the Mega Drive, accurate (its sound in particular): a second core for the Mega Drive,
	  chosen in Settings > Other systems > Mega Drive. Upstream's PicoDrive stays the default.

	  https://github.com/libretro/Genesis-Plus-GX
```

## kiwami/package/kiwami-libretro-mesen/Config.in
```kconfig
config BR2_PACKAGE_KIWAMI_LIBRETRO_MESEN
	bool "kiwami-libretro-mesen"
	depends on BR2_PACKAGE_RETROARCH
	depends on BR2_INSTALL_LIBSTDCPP
	help
	  Mesen, the NES and Famicom, accurate: a second core for the NES, chosen in Settings > Other systems > NES.
	  Upstream's FCEUmm stays the default.

	  https://github.com/libretro/Mesen
```

## kiwami/package/kiwami-libretro-sameboy/Config.in
```kconfig
config BR2_PACKAGE_KIWAMI_LIBRETRO_SAMEBOY
	bool "kiwami-libretro-sameboy"
	depends on BR2_PACKAGE_RETROARCH
	help
	  SameBoy, the Game Boy and Game Boy Color, accurate, with its own open boot ROMs (no BIOS needed): a second
	  core for both, chosen per system in Settings > Other systems. Upstream's Gambatte stays the default.

	  https://github.com/libretro/SameBoy
```

## kiwami/package/kiwami-romm/Config.in
```kconfig
config BR2_PACKAGE_KIWAMI_ROMM
	bool "kiwami-romm"
	depends on BR2_INSTALL_LIBSTDCPP
	select BR2_PACKAGE_LIBCURL # dlopen()ed at run time
	help
	  The fork's RomM client: /usr/libexec/kiwami/romm, the helper that pairs with a RomM server (5.4) and syncs
	  the games' saves with it, built from ui/src/kiwami/romm/.

	  https://github.com/rommapp/romm
```

## kiwami/package/kiwami-tailscale/Config.in
```kconfig
config BR2_PACKAGE_KIWAMI_TAILSCALE
	bool "kiwami-tailscale"
	depends on BR2_PACKAGE_HOST_GO_TARGET_ARCH_SUPPORTS
	select BR2_PACKAGE_HOST_GO
	help
	  Tailscale (Settings > Network > Tailscale): one tailscaled binary with the CLI built in, tailscale a link to
	  it, the features the handheld doesn't use left out. Kernel mode with the tun module, netfilter left off.

	  Buildroot's own tailscale package is not to be used instead: it is older, and it switches netfilter on in
	  the kernel, which Banana keeps off.

	  https://github.com/tailscale/tailscale
```
