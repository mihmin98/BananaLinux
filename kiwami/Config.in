## kiwami/Config.in
```kconfig
menu "Kiwami"
source "$BR2_EXTERNAL_KIWAMI_PATH/package/kiwami-tailscale/Config.in"
source "$BR2_EXTERNAL_KIWAMI_PATH/package/kiwami-libretro-mesen/Config.in"
source "$BR2_EXTERNAL_KIWAMI_PATH/package/kiwami-libretro-sameboy/Config.in"
source "$BR2_EXTERNAL_KIWAMI_PATH/package/kiwami-libretro-genesis-plus-gx/Config.in"

config BR2_PACKAGE_KIWAMI_RETROARCH_MASTER
	bool "RetroArch's master instead of v1.22.2"
	depends on BR2_PACKAGE_RETROARCH
	help
	  RetroArch built from its master branch at the commit kiwami/local.mk pins, with the fork's patches
	  (kiwami/patches/retroarch/) instead of upstream's. Off, RetroArch is upstream's release.

config BR2_PACKAGE_KIWAMI_GLSL_SHADERS_PRECISION
	bool "RetroArch's GLSL shaders as libretro wrote them"
	depends on BR2_PACKAGE_RETROARCH_GLSL_SHADERS
	help
	  The shaders in /usr/share/libretro/shaders/glsl as libretro wrote them, the vertex stage at highp only in a
	  shader whose fragment stage is highp (kiwami/glsl-shaders.sh), instead of upstream's rewrite of every vertex
	  stage, which most of them then fail to compile or link with. Off, upstream's.

config BR2_PACKAGE_KIWAMI_OTA_OFF
	bool "Over-the-air updates off"
	help
	  Settings > System > Update no longer checks or downloads upstream's releases (GitHub, the beta channel), which
	  would replace the fork: kiwami/post-build.sh sends the update script's check, download and beta-login to
	  /usr/libexec/kiwami/ota-off, which says so. Update packages on the card still install. Off, upstream's updates.
endmenu
```
